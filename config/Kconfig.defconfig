## config/Kconfig.defconfig
```kconfig
# Copyright (c) 2022 The ZMK Contributors
# SPDX-License-Identifier: MIT

if SHIELD_SAXOPHONE

config ZMK_KEYBOARD_NAME
    default "saxophone"

endif
```

## config/boards/Kconfig.shield
```kconfig
# Copyright (c) 2022 The ZMK Contributors
# SPDX-License-Identifier: MIT

config SHIELD_SAXOPHONE
    def_bool $(shields_list_contains,saxophone)
```
